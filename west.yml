## west.yml
```yaml
manifest:
  remotes:
    - name: zephyrproject-rtos
      url-base: https://github.com/zephyrproject-rtos

  projects:
    - name: zephyr
      remote: zephyrproject-rtos
      revision: v4.4.0
      import:
        name-allowlist:
          - cmsis_6
          - hal_stm32
          - mbedtls
          - mcuboot
          - net-tools
          - picolibc
          - openthread

  self:
    path: h747-demo
```
